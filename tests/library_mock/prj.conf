## CMakeLists.txt
```
cmake_minimum_required(VERSION 3.20.0)
find_package(Zephyr REQUIRED HINTS $ENV{ZEPHYR_BASE})
project(__MODULE_NAME___library_mock_test)

file(GLOB app_sources src/*.c)
target_sources(app PRIVATE ${app_sources})

zephyr_include_directories(${CMAKE_CURRENT_SOURCE_DIR}/../../drivers/__SUBSYS__/__DRIVER_SLUG__)
```

## prj.conf
```kconfig
CONFIG_ZTEST=y
CONFIG___KCONFIG_SYM__=y
CONFIG___KCONFIG_SYM___BACKEND_LIBRARY_MOCK=y
```

## src/main.c
```c
/*
 * Integration tests for the __DRIVER_SLUG__ driver with the library-mock backend.
 */

#include <zephyr/device.h>
#include <zephyr/ztest.h>

#include "__DRIVER_SLUG__.h"

ZTEST(__DRIVER_SLUG___library_mock, test_boot)
{
	/* Placeholder: remove once real integration tests are added. */
	zassert_true(true);
}

/*
 * Example integration test (uncomment once the driver API is defined):
 *
 * ZTEST(__DRIVER_SLUG___library_mock, test_device_ready)
 * {
 *	const struct device *dev = DEVICE_DT_GET(DT_NODELABEL(__DRIVER_SLUG___0));
 *
 *	zassert_true(device_is_ready(dev));
 * }
 */

ZTEST_SUITE(__DRIVER_SLUG___library_mock, NULL, NULL, NULL, NULL, NULL);
```
