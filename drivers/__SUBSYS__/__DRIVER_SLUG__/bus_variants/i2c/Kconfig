## drivers/__SUBSYS__/__DRIVER_SLUG__/bus_variants/i2c/Kconfig
```kconfig
config __KCONFIG_SYM__
	bool "__DRIVER_UPPER__ driver"
	depends on __DT_HAS_ENABLED__
	select I2C
	help
	  Enable the __DRIVER_UPPER__ Zephyr driver module.

if __KCONFIG_SYM__

choice
	prompt "__DRIVER_UPPER__ backend"
	default __KCONFIG_SYM___BACKEND_PUBLIC_MOCK

config __KCONFIG_SYM___BACKEND_HARDWARE
	bool "Hardware (real device over bus)"
	select __KCONFIG_SYM___USES_LIB
	help
	  Use the device library with a real bus transfer function.

config __KCONFIG_SYM___BACKEND_SIMULATION
	bool "Simulation (socket to Basilisk)"
	select __KCONFIG_SYM___USES_LIB
	help
	  Use the device library with a socket transfer function for SITL.

config __KCONFIG_SYM___BACKEND_LIBRARY_MOCK
	bool "Library mock (static register data via device library)"
	select __KCONFIG_SYM___USES_LIB
	help
	  Use the device library with a static register-map transfer function.

config __KCONFIG_SYM___BACKEND_PUBLIC_MOCK
	bool "Public mock (hardcoded data, no library required)"
	help
	  Return hardcoded data from the Zephyr driver API without linking the
	  device library. Safe for CI and repos without NDA library access.

endchoice

config __KCONFIG_SYM___USES_LIB
	bool
	help
	  Hidden symbol: set when a backend requires the device library.

endif
```

## dts/bindings/__SUBSYS__/__VENDOR__,__DRIVER_SLUG__.yaml
```yaml
description: __DRIVER_UPPER__ device driver

compatible: "__COMPAT__"

include: i2c-device.yaml

properties:
  # TODO: Declare devicetree properties (mirror struct __DRIVER_SLUG___config).
  # TODO: For UART-based NDA devices, replace include with uart-device.yaml and
  #       update the transfer backends accordingly.
```

## template/common/tests/integration/testcase.yaml
```yaml
tests:
  __MODULE_NAME__.integration:
    tags:
      - drivers
      - __SUBSYS__
    platform_allow:
      - qemu_cortex_m3
    # TODO: Hardware drivers also need boards/qemu_cortex_m3.overlay (emulator bus).
```

## template/common/tests/unit/testcase.yaml
```yaml
tests:
  __MODULE_NAME__.unit:
    tags:
      - drivers
      - __SUBSYS__
    platform_allow:
      - native_sim
    # TODO: Add harness/filter options as needed.
```

## template/hardware/drivers/__SUBSYS__/__DRIVER_SLUG__/Kconfig
```kconfig
config __KCONFIG_SYM__
	bool "__DRIVER_UPPER__ driver (hardware)"
	depends on __DT_HAS_ENABLED__
	select I2C
	help
	  Enable the hardware driver for the __DRIVER_UPPER__.

	  TODO: Update bus selection (I2C, SPI, etc.) to match your device.

config __KCONFIG_SYM___EMUL
	bool "Emulator for __DRIVER_UPPER__"
	depends on __KCONFIG_SYM__ && EMUL
	default y if EMUL
	select I2C_EMUL
	help
	  Build the device emulator. Used by integration tests and SITL.

if __KCONFIG_SYM___EMUL

choice
	prompt "__DRIVER_UPPER__ emulator backend"
	default __KCONFIG_SYM___EMUL_BACKEND_INTEGRATION

config __KCONFIG_SYM___EMUL_BACKEND_INTEGRATION
	bool "Integration (self-contained ztest emulation)"

config __KCONFIG_SYM___EMUL_BACKEND_SITL
	bool "SITL (expose port for Basilisk)"

endchoice

endif
```

## template/hardware/dts/bindings/__SUBSYS__/__VENDOR__,__DRIVER_SLUG__.yaml
```yaml
description: __DRIVER_UPPER__ __DEVICE__ device driver

compatible: "__COMPAT__"

include: i2c-device.yaml

properties:
  # TODO: Declare devicetree properties (mirror struct __DRIVER_SLUG___config).
```

## template/hardware/tests/sitl/testcase.yaml
```yaml
tests:
  __MODULE_NAME__.sitl:
    tags:
      - drivers
      - __SUBSYS__
      - sitl
    platform_allow:
      - qemu_cortex_m3
    build_only: true
    # Basilisk is not available in CI; verify the SITL image builds only.
```

## template/mock/drivers/__SUBSYS__/__DRIVER_SLUG___mock/Kconfig
```kconfig
config __KCONFIG_SYM__
	bool "Mock __DRIVER_UPPER__ (static test data)"
	depends on __DT_HAS_ENABLED__
	help
	  Enable the mock __DRIVER_UPPER__ driver that returns static test data.
```

## template/mock/dts/bindings/__SUBSYS__/__VENDOR__,__DRIVER_SLUG__-mock.yaml
```yaml
description: Mock __DRIVER_UPPER__ for testing

compatible: "__COMPAT__"

include: base.yaml
```

## tests/library_mock/testcase.yaml
```yaml
tests:
  __MODULE_NAME__.library_mock:
    tags:
      - drivers
      - __SUBSYS__
    platform_allow:
      - qemu_cortex_m3
```

## tests/public_mock/testcase.yaml
```yaml
tests:
  __MODULE_NAME__.public_mock:
    tags:
      - drivers
      - __SUBSYS__
    platform_allow:
      - native_sim
```

## tests/simulation/testcase.yaml
```yaml
tests:
  __MODULE_NAME__.simulation:
    tags:
      - drivers
      - __SUBSYS__
      - simulation
    platform_allow:
      - qemu_cortex_m3
    build_only: true
    # Basilisk is not available in CI; verify the simulation image builds only.
```
