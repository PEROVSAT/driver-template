## CMakeLists.txt
```
cmake_minimum_required(VERSION 3.20.0)
find_package(Zephyr REQUIRED HINTS $ENV{ZEPHYR_BASE})
project(__MODULE_NAME___simulation_test)

file(GLOB app_sources src/*.c)
target_sources(app PRIVATE ${app_sources})
```

## prj.conf
```kconfig
CONFIG_ZTEST=y
CONFIG___KCONFIG_SYM__=y
CONFIG___KCONFIG_SYM___BACKEND_SIMULATION=y
```

## src/main.c
```c
/*
 * Simulation harness: boots the driver with the simulation backend.
 *
 * TODO: Connect Basilisk here once the socket backend is implemented.
 */

#include <zephyr/kernel.h>

int main(void)
{
	/* connect Basilisk here */

	while (true) {
		k_sleep(K_FOREVER);
	}

	return 0;
}
```
