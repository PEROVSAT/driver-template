## CMakeLists.txt
```
cmake_minimum_required(VERSION 3.20.0)
find_package(Zephyr REQUIRED HINTS $ENV{ZEPHYR_BASE})
project(__MODULE_NAME___unit_test)

file(GLOB app_sources src/*.c)
target_sources(app PRIVATE ${app_sources})

zephyr_include_directories(${CMAKE_CURRENT_SOURCE_DIR}/../../drivers/__SUBSYS__/__DRIVER_BASE__)
```

## prj.conf
```kconfig
CONFIG_ZTEST=y
CONFIG___KCONFIG_SYM__=y
CONFIG_EMUL=y
CONFIG_I2C_EMUL=y
```

## src/main.c
```c
/*
 * Unit tests for internal __DRIVER_BASE__ driver helpers.
 *
 * Expose non-static helpers in __DRIVER_BASE__.h, then add ZTEST cases below.
 */

#include <zephyr/ztest.h>

#include "__DRIVER_BASE__.h"

ZTEST(__DRIVER_SLUG___unit, test_boot)
{
	/* Placeholder: remove once real unit tests are added. */
	zassert_true(true);
}

/*
 * Example unit test (uncomment after exposing internal helpers in __DRIVER_BASE__.h):
 *
 * ZTEST(__DRIVER_SLUG___unit, test_internal_helper)
 * {
 *	zassert_ok(my_internal_helper());
 * }
 */

ZTEST_SUITE(__DRIVER_SLUG___unit, NULL, NULL, NULL, NULL, NULL);
```
